## main/Kconfig.projbuild
```kconfig
menu "Geek Recorder Configuration"

config GEEK_LCD_DRIVER_ST7789
    bool "LCD panel is ST7789"
    default y

config GEEK_LCD_HOST
    int "SPI host for LCD (2=SPI2, 3=SPI3)"
    range 2 3
    default 2

config GEEK_LCD_GPIO_DC
    int "LCD DC GPIO"
    default 8

config GEEK_LCD_GPIO_CS
    int "LCD CS GPIO"
    default 10

config GEEK_LCD_GPIO_SCLK
    int "LCD SCLK GPIO"
    default 12

config GEEK_LCD_GPIO_MOSI
    int "LCD MOSI GPIO"
    default 11

config GEEK_LCD_GPIO_RST
    int "LCD RST GPIO"
    default 9

config GEEK_LCD_GPIO_BL
    int "LCD Backlight GPIO"
    default 7

config GEEK_LCD_HRES
    int "LCD horizontal resolution"
    default 240

config GEEK_LCD_VRES
    int "LCD vertical resolution"
    default 135

config GEEK_MIC_PDM_CLK
    int "PDM mic CLK GPIO"
    default 14

config GEEK_MIC_PDM_DATA
    int "PDM mic DATA GPIO"
    default 13

config GEEK_MIC_SEL_GPIO
    int "PDM mic SEL GPIO"
    default 6

config GEEK_MIC_SAMPLE_RATE
    int "PDM mic sample rate (Hz)"
    default 16000

config GEEK_SDMMC_CLK
    int "SDMMC CLK GPIO"
    default 36

config GEEK_SDMMC_CMD
    int "SDMMC CMD GPIO"
    default 35

config GEEK_SDMMC_D0
    int "SDMMC D0 GPIO"
    default 37

config GEEK_SDMMC_D1
    int "SDMMC D1 GPIO"
    default 33

config GEEK_SDMMC_D2
    int "SDMMC D2 GPIO"
    default 38

config GEEK_SDMMC_D3
    int "SDMMC D3 GPIO"
    default 34

config GEEK_HTTP_PORT
    int "HTTP server port"
    default 80

config GEEK_AP_PASSWORD
    string "Provisioning AP password (>=8 chars, WPA2-PSK)"
    default "geek12345"
    help
      Password for the device provisioning SoftAP. If empty or shorter than
      8 characters, the AP will run open (no password). For best stability
      on some clients, set a WPA2 password.

endmenu

menu "Geek Recorder UI"

config GEEK_USE_LVGL
    bool "Enable LVGL UI (recommended for CJK)"
    default y

config GEEK_LVGL_TASK_STACK
    int "LVGL task stack size"
    depends on GEEK_USE_LVGL
    default 4096

endmenu

menu "Geek Recorder Network"

config GEEK_WS_ENABLE
    bool "Enable ASR WebSocket client"
    default y

config GEEK_WS_URI
    string "WebSocket URI"
    default "wss://dashscope.aliyuncs.com/api-ws/v1/inference"
    help
      Full WebSocket URI. Adjust if the service endpoint changes.

config GEEK_WS_ORIGIN
    string "WebSocket Origin header (optional)"
    default "https://dashscope.aliyuncs.com"
    help
      Optional Origin header value. Leave empty to omit.

config GEEK_WS_SUBPROTOCOL
    string "WebSocket Sec-WebSocket-Protocol (optional)"
    default ""
    help
      Optional subprotocol required by some services. Leave empty to omit.

endmenu

menu "Geek Recorder Debug"

config GEEK_DEBUG_LOG_WIFI_CREDENTIALS
    bool "Log Wi-Fi SSID and password in plaintext (DANGEROUS)"
    default n
    help
      When enabled, the firmware will print the saved/provisioned Wi-Fi SSID
      and password in plaintext to the serial log for troubleshooting. This is
      extremely insecure and should NEVER be enabled in production or when
      logs may be shared. Disable immediately after debugging.

endmenu
```

## sdkconfig.defaults
```kconfig
# Target chip
CONFIG_IDF_TARGET="esp32s3"

# Console
CONFIG_LOG_DEFAULT_LEVEL_INFO=y

# HTTP Server
CONFIG_HTTPD_MAX_REQ_HDR_LEN=2048
CONFIG_HTTPD_MAX_URI_LEN=1024

# TLS CA Store for wss
CONFIG_MBEDTLS_CERTIFICATE_BUNDLE=y
CONFIG_MBEDTLS_CERTIFICATE_BUNDLE_DEFAULT_FULL=y
CONFIG_MBEDTLS_CUSTOM_CERTIFICATE_BUNDLE=n

# Use custom partition table with larger app partition
CONFIG_PARTITION_TABLE_CUSTOM=y
CONFIG_PARTITION_TABLE_CUSTOM_FILENAME="partitions.csv"
CONFIG_PARTITION_TABLE_FILENAME="partitions.csv"

# LVGL color depth and swap for RGB565
CONFIG_LV_COLOR_DEPTH_16=y
CONFIG_LV_COLOR_DEPTH_32=n
CONFIG_LV_COLOR_16_SWAP=y
# Debug: print plaintext Wi‑Fi credentials (DANGEROUS; enable only for local debugging)
CONFIG_GEEK_DEBUG_LOG_WIFI_CREDENTIALS=y
```
